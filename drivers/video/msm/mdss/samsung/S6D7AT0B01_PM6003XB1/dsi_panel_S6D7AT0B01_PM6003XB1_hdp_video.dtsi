/* Copyright (c) 2013-14, Samsung Electronics Corporation. All rights reserved.
 *
 * This program is free software; you can redistribute it and/or modify
 * it under the terms of the GNU General Public License version 2 and
 * only version 2 as published by the Free Software Foundation.
 *
 * This program is distributed in the hope that it will be useful,
 * but WITHOUT ANY WARRANTY; without even the implied warranty of
 * MERCHANTABILITY or FITNESS FOR A PARTICULAR PURPOSE.  See the
 * GNU General Public License for more details.
 */

/*---------------------------------------------------------------------------
 * This file is autogenerated file using gcdb parser. Please do not edit it.
 * Update input XML file to add a new entry or update variable in this file
 * VERSION = "1.0"
 *---------------------------------------------------------------------------*/
&mdss_mdp {
	ss_dsi_panel_S6D7AT0B01_PM6003XB1_HDP: ss_dsi_panel_S6D7AT0B01_PM6003XB1_HDP {
		qcom,mdss-dsi-panel-name = "ss_dsi_panel_S6D7AT0B01_PM6003XB1_HDP";
		qcom,mdss-dsi-panel-controller = <&mdss_dsi0>;
		qcom,mdss-dsi-panel-width = <720>;
		qcom,mdss-dsi-panel-height = <1480>;
		qcom,mdss-dsi-bpp = <24>;
		qcom,mdss-dsi-panel-destination = "display_1";
		qcom,mdss-dsi-panel-timings = [97 22 16 00 48 4C 1A 26 1B 03 04 00];
		qcom,mdss-dsi-on-command = [

			/* PASS WD */
			39 01 00 00 00 00 03 F0 5A 5A
			39 01 00 00 00 00 03 F1 5A 5A
			39 01 00 00 00 00 03 FC 5A 5A

			/* TDDI_CTL1 */
			39 01 00 00 00 00 02 71 0A

			/* TDDI Control3 */
			39 01 00 00 00 00 07 73 B0 64 00 01 68 00

			/* DISP_RSEL */
			39 01 00 00 00 00 05 B1 11 22 11 00

			/* Display Control 1  */
			39 01 00 00 00 00 11 B3 01 B9 07
									70 18 68 08
									08 07 80 00
									E5 00 E5 00
									E5

			/* DISP_TSC1  */
			39 01 00 00 00 00 58 BA 01 13 02
									13 02 13 02
									88 02 58 00
									84 08 43 07
									05 C1 00 94
									00 14 00 01
									26 01 10 C2
									89 50 2C 99
									46 46 00 01
									F1 01 01 28
									32 38 3F 48
									50 54 FF FF
									FF FF FF FF
									FF FF FF 2F
									48 64 98 BF
									DF FF FF FF
									FF FF FF FF
									FF FF 00 00
									08 00 00 00
									00 00 00 00
									00 00 00 00
									00 00 00 00

			/* Abnormal Control  */
			39 01 00 00 00 00 05 BB 21 68 00 00

			/* GOUTLR_CTL  */
			39 01 00 00 00 00 2D EC 00 08 00
									07 00 15 14
									02 0F 0D 0C
									0E 05 09 06
									02 02 00 00
									02 03 03 02
									08 02 07 02
									15 14 02 0E
									0C 0F 0D 04
									09 06 02 02
									00 00 02 03
									03

			/* GG_GSP  */
			39 01 00 00 00 00 48 ED 12 40 00
									15 11 00 0C
									13 40 00 15
									11 00 0C 00
									01 00 00 00
									00 10 00 41
									00 00 00 00
									10 00 01 00
									00 00 00 20
									00 21 00 00
									00 00 10 00
									40 01 72 61
									00 E0 20 41
									01 72 61 00
									C0 40 08 92
									4C 40 00 80
									28 00 3C 00
									00 00 00 00

			/* GG_GCK */
			39 01 00 00 00 00 25 EE 12 C4 80
									19 05 06 00
									00 68 12 C5
									80 19 05 06
									00 00 68 12
									C6 80 19 05
									06 00 00 6A
									12 C7 80 19
									05 06 00 00
									6A

			/* GG_CTRL */
			39 01 00 00 00 00 3C EF 00 00 00
									00 00 0C 40
									76 76 10 18
									09 80 00 08
									50 10 00 00
									48 00 00 00
									00 00 00 00
									00 00 00 11
									77 00 22 00
									00 00 00 00
									00 00 00 00
									00 00 00 00
									00 00 00 00
									00 00 00 00
									00 00 00 00

			/* Source Control */
			39 01 00 00 00 00 1B F2 48 22 33
									33 E3 4C 43
									80 01 00 00
									0D 8C 00 80
									00 A6 1E 08
									03 34 00 00
									00 00 00

			/* ETC */
			39 01 00 00 00 00 32 F9 88 88 00
									C0 C0 04 7A
									00 0D C0 94
									0C 4B A0 1F
									A0 00 00 00
									00 00 0C 00
									10 00 00 00
									00 00 00 00
									0C 00 11 00
									00 00 00 00
									00 00 0C 00
									11 00 00 77
									00 00

			/* EDS TEST 0 */
			39 01 00 00 00 00 13 FE 02 00 01
									4C 00 00 00
									60 00 03 00
									00 00 00 00
									00 00 00

			/* EDS TEST 0 */
			39 01 00 00 00 00 10 C0 01 08 29
									00 00 7F 01
									20 0F FF 30
									40 86 DA 8E

			/* CABC Control 2 */
			39 01 00 00 00 00 25 C1 BF 7F 7F
									25 66 7D 7F
									82 8A 8C 94
									A0 AE BA C2
									D4 DE F0 FA
									FF 88 96 A5
									B4 BE C8 CD
									D0 D3 D7 DF
									E6 EA F0 F5
									FF

			/* ESDFG*/
			39 01 00 00 00 00 18 C8 00 24 00
									41 3A 00 00
									00 B0 02 00
									00 00 85 48
									00 00 00 00
									00 00 40 4B 

			/*GAMMA*/
			39 01 00 00 00 00 23 E8 01 09 12
									0C 12 19 18
									1A 21 25 26
									26 25 25 22
									30 32 01 09
									12 0C 12 19
									18 1A 21 25
									26 26 25 25
									22 30 32
									
			/* WRDISBV */
			39 01 00 00 00 00 02 51 FF
			
			/* WRCTRLD */
			39 01 00 00 00 00 02 53 24
			
			/* WRCABC */
			39 01 00 00 00 00 02 55 00

			/* Sleep Out */
			05 01 00 00 78 00 02 11 00 /* Wait 120 ms */
		];
		qcom,mdss-dsi-off-command = [

			/* Display Off and Wait 1 frame = 16.67 ms minimum */
			05 01 00 00 14 00 02 28 00

			/* Sleep in and Wait 5 frame =~ 90 ms minimum */
			05 01 00 00 5A 00 02 10 00
		];

		qcom,mdss-dsi-h-back-porch = <100>;
		qcom,mdss-dsi-v-back-porch = <8>;
		qcom,mdss-dsi-v-front-porch = <56>;
		qcom,mdss-dsi-v-pulse-width = <8>;
		qcom,mdss-dsi-h-front-porch = <100>;
		qcom,mdss-dsi-h-pulse-width = <40>;

		qcom,mdss-dsi-h-sync-skew = <0>;
		qcom,mdss-dsi-h-left-border = <0>;
		qcom,mdss-dsi-h-right-border = <0>;
		qcom,mdss-dsi-v-top-border = <0>;
		qcom,mdss-dsi-v-bottom-border = <0>;
		qcom,mdss-dsi-underflow-color = <0xff>;
		qcom,mdss-dsi-border-color = <0>;
		qcom,mdss-dsi-bl-pmic-control-type = "bl_ctrl_dcs";
		qcom,mdss-dsi-bl-min-level = <1>;
		qcom,mdss-dsi-bl-max-level = <256>;
		qcom,mdss-brightness-max-level = <256>;
		qcom,mdss-dsi-panel-type = "dsi_video_mode";
		qcom,mdss-dsi-h-sync-pulse = <1>;
		/*qcom,mdss-dsi-hfp-power-mode;
		qcom,mdss-dsi-bllp-eof-power-mode;*/
		qcom,mdss-dsi-hbp-power-mode;
		qcom,mdss-dsi-bllp-power-mode;
		qcom,mdss-dsi-traffic-mode = "burst_mode";
		qcom,mdss-dsi-pixel-packing = "loose";
		qcom,mdss-dsi-virtual-channel-id = <0>;
		qcom,mdss-dsi-color-order = <0>;
		qcom,mdss-dsi-lane-0-state;
		qcom,mdss-dsi-lane-1-state;
		qcom,mdss-dsi-lane-2-state;
		qcom,mdss-dsi-lane-3-state;
		qcom,mdss-dsi-t-clk-post = <0x04>;
		qcom,mdss-dsi-t-clk-pre = <0x1E>;
		qcom,mdss-dsi-stream = <0>;
		qcom,mdss-dsi-mdp-trigger = "none";
		qcom,mdss-dsi-dma-trigger = "trigger_sw";
		qcom,mdss-dsi-panel-framerate = <60>;
		/*qcom,mdss-dsi-panel-clockrate = <600000000>;*/
		qcom,mdss-dsi-on-command-state = "dsi_lp_mode";
		qcom,mdss-dsi-off-command-state = "dsi_hs_mode";
		qcom,mdss-pan-physical-width-dimension = <66>;
		qcom,mdss-pan-physical-height-dimension = <137>;
		qcom,mdss-dsi-lp11-init;
		qcom,mdss-dsi-init-delay-us = <2000>;
		qcom,mdss-dsi-rx-eot-ignore;
		qcom,mdss-dsi-tx-eot-append;
		qcom,mdss-dsi-reset-sequence = <1 10>, <0 10>, <1 10>;

/*
 * ************************************************************************************************************************************
 *
 *
 *			Below  parameters are samsung dependent thigs
 *
 *
 * ************************************************************************************************************************************
 */
		samsung,panel-vendor = "CSOT";
		samsung,tft-common-support;
		samsung,enter_hbm_lux = <20000>;

		qcom,mdss-dsi-force-clock-lane-hs;

		samsung,packet_size_tx_cmds_revA = [
			37 01 00 00 00 00 02 07 00
		];

		samsung,display_on_tx_cmds_revA = [

			/* Display On and Wait 1 frame = 16.67 ms minimum */
			05 01 00 00 14 00 02 29 00
			
			 /* TE on */
			15 01 00 00 00 00 02 35 00
		];

		samsung,display_off_tx_cmds_revA = [05 01 00 00 00 00 02 28 00];

		/*
		 * First parameters can be changed
		 * by function of samsung_nv_read()
		 * because of that means offset of
		 * read position
		 */
		samsung,reg_read_pos_tx_cmds_revA = [
			15 01 00 00 00 00 02 B0 00
		];
		samsung,manufacture_id0_rx_cmds_revA = [06 01 00 00 00 00 01 da 01 00];
		samsung,manufacture_id1_rx_cmds_revA = [06 01 00 00 00 00 01 db 01 00];
		samsung,manufacture_id2_rx_cmds_revA = [06 01 00 00 00 00 01 dc 01 00];

		samsung,mtp_read_sysfs_rx_cmds_revA = [06 01 00 00 00 00 01 00 00 00];

		samsung,tft_pwm_tx_cmds_revA=[
			39 01 00 00 00 00 03 51 FF FF
		];
		/*
		* ************************************************************************************************************************
		* Scaled level to index mappings
		* ************************************************************************************************************************
		*/
		samsung,candela_map_table_revA = <
		/*<idx>	  <from>  <till> <scaled_level> */
			0		0		0		0
			1		1		1		0
			2		2		2		20
			3		3		3		28
			4		4		4		36
			5		5		5		44
			6		6		6		53
			7		7		7		61
			8		8		8		69
			9		9		9		78
			10		10		10		86
			11		11		11		94
			12		12		12		103
			13		13		13		111
			14		14		14		119
			15		15		15		127
			16		16		16		136
			17		17		17		144
			18		18		18		152
			19		19		19		161
			20		20		20		169
			21		21		21		177
			22		22		22		186
			23		23		23		194
			24		24		24		202
			25		25		25		210
			26		26		26		219
			27		27		27		227
			28		28		28		235
			29		29		29		244
			30		30		30		252
			31		31		31		260
			32		32		32		269
			33		33		33		277
			34		34		34		285
			35		35		35		293
			36		36		36		302
			37		37		37		310
			38		38		38		318
			39		39		39		327
			40		40		40		335
			41		41		41		343
			42		42		42		352
			43		43		43		360
			44		44		44		368
			45		45		45		376
			46		46		46		385
			47		47		47		393
			48		48		48		401
			49		49		49		410
			50		50		50		418
			51		51		51		426
			52		52		52		435
			53		53		53		443
			54		54		54		451
			55		55		55		459
			56		56		56		468
			57		57		57		476
			58		58		58		484
			59		59		59		493
			60		60		60		501
			61		61		61		509
			62		62		62		518
			63		63		63		526
			64		64		64		534
			65		65		65		543
			66		66		66		551
			67		67		67		559
			68		68		68		567
			69		69		69		576
			70		70		70		584
			71		71		71		592
			72		72		72		601
			73		73		73		609
			74		74		74		617
			75		75		75		626
			76		76		76		634
			77		77		77		642
			78		78		78		650
			79		79		79		659
			80		80		80		667
			81		81		81		675
			82		82		82		684
			83		83		83		692
			84		84		84		700
			85		85		85		709
			86		86		86		717
			87		87		87		725
			88		88		88		733
			89		89		89		742
			90		90		90		750
			91		91		91		758
			92		92		92		767
			93		93		93		775
			94		94		94		783
			95		95		95		792
			96		96		96		800
			97		97		97		808
			98		98		98		816
			99		99		99		825
			100		100		100		833
			101		101		101		841
			102		102		102		850
			103		103		103		858
			104		104		104		866
			105		105		105		875
			106		106		106		883
			107		107		107		891
			108		108		108		899
			109		109		109		908
			110		110		110		916
			111		111		111		924
			112		112		112		933
			113		113		113		941
			114		114		114		949
			115		115		115		958
			116		116		116		966
			117		117		117		974
			118		118		118		982
			119		119		119		991
			120		120		120		999
			121		121		121		1007
			122		122		122		1016
			123		123		123		1024
			124		124		124		1032
			125		125		125		1041
			126		126		126		1049
			127		127		127		1057
			128		128		128		1066
			129		129		129		1080
			130		130		130		1094
			131		131		131		1109
			132		132		132		1123
			133		133		133		1137
			134		134		134		1152
			135		135		135		1166
			136		136		136		1181
			137		137		137		1195
			138		138		138		1209
			139		139		139		1224
			140		140		140		1238
			141		141		141		1253
			142		142		142		1267
			143		143		143		1281
			144		144		144		1296
			145		145		145		1310
			146		146		146		1324
			147		147		147		1339
			148		148		148		1353
			149		149		149		1368
			150		150		150		1382
			151		151		151		1396
			152		152		152		1411
			153		153		153		1425
			154		154		154		1440
			155		155		155		1454
			156		156		156		1468
			157		157		157		1483
			158		158		158		1497
			159		159		159		1511
			160		160		160		1526
			161		161		161		1540
			162		162		162		1555
			163		163		163		1569
			164		164		164		1583
			165		165		165		1598
			166		166		166		1612
			167		167		167		1627
			168		168		168		1641
			169		169		169		1655
			170		170		170		1670
			171		171		171		1684
			172		172		172		1698
			173		173		173		1713
			174		174		174		1727
			175		175		175		1742
			176		176		176		1756
			177		177		177		1770
			178		178		178		1785
			179		179		179		1799
			180		180		180		1814
			181		181		181		1828
			182		182		182		1842
			183		183		183		1857
			184		184		184		1871
			185		185		185		1885
			186		186		186		1900
			187		187		187		1914
			188		188		188		1929
			189		189		189		1943
			190		190		190		1957
			191		191		191		1972
			192		192		192		1986
			193		193		193		2001
			194		194		194		2015
			195		195		195		2029
			196		196		196		2044
			197		197		197		2058
			198		198		198		2073
			199		199		199		2087
			200		200		200		2101
			201		201		201		2116
			202		202		202		2130
			203		203		203		2144
			204		204		204		2159
			205		205		205		2173
			206		206		206		2188
			207		207		207		2202
			208		208		208		2216
			209		209		209		2231
			210		210		210		2245
			211		211		211		2260
			212		212		212		2274
			213		213		213		2288
			214		214		214		2303
			215		215		215		2317
			216		216		216		2331
			217		217		217		2346
			218		218		218		2360
			219		219		219		2375
			220		220		220		2389
			221		221		221		2403
			222		222		222		2418
			223		223		223		2432
			224		224		224		2447
			225		225		225		2461
			226		226		226		2475
			227		227		227		2490
			228		228		228		2504
			229		229		229		2518
			230		230		230		2533
			231		231		231		2547
			232		232		232		2562
			233		233		233		2576
			234		234		234		2590
			235		235		235		2605
			236		236		236		2619
			237		237		237		2634
			238		238		238		2648
			239		239		239		2662
			240		240		240		2677
			241		241		241		2691
			242		242		242		2705
			243		243		243		2720
			244		244		244		2734
			245		245		245		2749
			246		246		246		2763
			247		247		247		2777
			248		248		248		2792
			249		249		249		2806
			250		250		250		2821
			251		251		251		2835
			252		252		252		2849
			253		253		253		2864
			254		254		254		2878
			255		255		255		2893
			256		256		256		3400
		>;
	};
};
