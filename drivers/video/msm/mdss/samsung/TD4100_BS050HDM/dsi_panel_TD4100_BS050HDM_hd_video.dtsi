/* Copyright (c) 2013-14, Samsung Electronics Corporation. All rights reserved.
 *
 * This program is free software; you can redistribute it and/or modify
 * it under the terms of the GNU General Public License version 2 and
 * only version 2 as published by the Free Software Foundation.
 *
 * This program is distributed in the hope that it will be useful,
 * but WITHOUT ANY WARRANTY; without even the implied warranty of
 * MERCHANTABILITY or FITNESS FOR A PARTICULAR PURPOSE.  See the
 * GNU General Public License for more details.
 */

/*---------------------------------------------------------------------------
 * This file is autogenerated file using gcdb parser. Please do not edit it.
 * Update input XML file to add a new entry or update variable in this file
 * VERSION = "1.0"
 *---------------------------------------------------------------------------*/
&mdss_mdp {
	ss_dsi_panel_TD4100_BS050HDM_HD: ss_dsi_panel_TD4100_BS050HDM_HD {
		qcom,mdss-dsi-panel-name = "ss_dsi_panel_TD4100_BS050HDM_HD";
		qcom,mdss-dsi-panel-controller = <&mdss_dsi0>;
		qcom,mdss-dsi-panel-width = <720>;
		qcom,mdss-dsi-panel-height = <1280>;
		qcom,mdss-dsi-bpp = <24>;
		qcom,mdss-dsi-panel-destination = "display_1";
		qcom,mdss-dsi-panel-timings = [B6 2C 1E 01 5A 5E 22 30 25 03 04 00];
		//qcom,mdss-dsi-panel-timings-8996 = ;
		qcom,mdss-dsi-on-command = [
			/* Initializing Sequence(1)*/
			39 00 00 00 00 00 02 B0 04
			39 00 00 00 00 00 04 B3 31 00 06
			39 00 00 00 00 00 08 B6 32 43 80 00 00 07 86
			39 00 00 00 00 00 07 B8 00 78 64 10 64 B4
			39 00 00 00 00 00 07 B9 00 78 64 10 64 B4
			39 00 00 00 00 00 07 BA 07 77 4A 0A 38 55
			39 00 00 00 00 00 04 BB 00 B4 A0
			39 00 00 00 00 00 04 BC 00 B4 A0
			39 00 00 00 00 00 04 BD 00 B4 A0
			39 00 00 00 00 00 02 BE 04
			39 00 00 00 00 00 12 C0 00 00 00 00 00 00 00 00 00 00 00 00 00 00 00 00 00
			39 00 00 00 00 00 23 C1 04 48 01 00 10 01 11 00 11 00 30 29 29 11 00 00 00 00 00 00 00 00 00 00 00 00 DF 00 20 80 01 00 00 00
			39 00 00 00 00 00 14 C2 02 F0 05 00 0A 0A 08 00 24 09 00 00 00 00 00 00 10 00 00
			39 00 00 00 00 00 40 C3 00 05 1C 00 00 00 00 00 00 00 00 02 83 00 00 00 02 84 00 00 01 01 03 28 01 00 01 01 00 00 00 00 00 00 00 00 00 00 00 00 00 00 00 00 00 00 00 00 00 00 28 00 00 00 00 00 28 00 00 00 40 20 00
			39 00 00 00 00 00 29 C4 70 01 00 00 00 00 00 00 00 00 00 00 00 00 00 00 00 00 00 00 00 00 00 00 00 00 00 00 00 00 00 00 00 00 00 00 00 00 01 01

			/* Initializing Sequence(2)*/
			39 00 00 00 00 00 0B C5 08 00 00 00 00 70 00 00 2D 41
			39 00 00 00 00 00 22 C6 B4 08 A0 00 00 08 A0 00 00 00 00 00 00 00 00 00 00 00 00 00 00 00 00 00 00 00 00 00 00 00 00 80 B4
			39 00 00 00 00 00 2F C7 08 25 35 48 57 62 7A 8A 96 A2 57 65 73 7E 86 91 9F AA BF 08 25 35 48 57 62 7A 8A 96 A1 4E 58 63 7E 86 91 9F AA BF 00 97 00 97 00 97 00 97
			39 00 00 00 00 00 37 C8 01 00 00 00 00 E8 00 00 00 00 00 FC 00 00 00 00 00 E6 00 00 00 00 00 E8 00 00 00 00 00 FC 00 00 00 00 00 E6 00 00 00 00 00 E8 00 00 00 00 00 FC 00 00 00 00 00 E6
			39 00 00 00 00 00 14 C9 00 00 00 00 00 FC 00 00 00 00 00 FC 00 00 00 00 00 FC 00
			39 00 00 00 00 00 2C CA 1D FC FC FC 00 0C FE 83 00 B8 EE D5 00 CC 00 DB 45 2B 00 00 EE F6 00 00 00 00 00 00 00 00 00 00 00 00 00 00 00 00 00 00 00 00 00
			39 00 00 00 00 00 2E CC 00 00 72 40 00 00 70 00 C4 10 14 D2 02 00 00 00 00 00 00 00 00 00 00 00 00 00 00 00 00 00 00 02 D2 16 12 C4 00 70 00 00 42 72 00 00 00

			/* Initializing Sequence(3)*/
			39 00 00 00 00 00 14 CD 0D 00 00 00 1F 00 00 00 00 7A 00 82 00 6E 00 82 01 00 00
			39 00 00 00 00 00 19 CE 7D 40 48 56 67 78 88 98 A7 B5 C3 D1 DE E9 F2 FA FF 04 00 01 03 45 00 00
			39 00 00 00 00 00 03 CF 48 10
			39 00 00 00 00 00 13 D0 11 03 45 C5 03 10 10 40 19 08 99 00 00 00 00 00 00 00
			39 00 00 00 00 00 02 D1 00
			39 00 00 00 00 00 1C D3 BB 3B 33 3B 44 3B 44 3B 00 00 EC 91 91 23 22 D4 D4 3B BB 4F D0 3C 10 12 10 00 10
			39 00 00 00 00 00 19 D4 80 04 04 33 00 04 00 00 00 00 00 00 00 00 00 00 00 00 0A 90 05 00 64 94
			39 00 00 00 00 00 02 D6 C1
			39 00 00 00 00 00 25 D7 F6 FF 03 05 43 24 80 1F C7 1F 1B 00 0F 01 20 08 F8 3F 00 00 00 40 A4 75 00 33 02 C0 AF CB 60 30 F4 03 3D 00
			39 00 00 00 00 00 09 D8 00 00 00 00 00 00 00 00
			39 00 00 00 00 00 05 DD 30 06 23 65
			39 00 00 00 00 00 05 DE 00 FF FF 50
			39 00 00 00 00 00 02 5E 02

			/* PWM INIT */
			39 00 00 00 00 00 02 B0 04
			39 00 00 00 00 00 02 51 00
			39 00 00 00 00 00 02 53 0C
			39 00 00 00 00 00 02 55 00
			39 01 00 00 00 00 02 35 00

			/* Display on Sequence(4) */
			05 01 00 00 00 00 02 11 00	/* Sleep Out & 120ms(0x78) Delay. 120ms delay wait at DISPLAY_ON cmd */
		];
		qcom,mdss-dsi-off-command = [
					05 01 00 00 00 00 02 28 00	/* no wait */
					05 01 00 00 50 00 02 10 00	/* wait 80ms(0x50) */
					];
		//qcom,mdss-dsi-post-panel-on-command = ;

		//qcom,cmd-sync-wait-broadcast = ;
		//qcom,mdss-dsi-fbc-enable = ;
		//qcom,mdss-dsi-fbc-slice-height = ;
		//qcom,mdss-dsi-fbc-2d-pred-mode = ;
		//qcom,mdss-dsi-fbc-ver2-mode = ;
		//qcom,mdss-dsi-fbc-bpp = ;
		//qcom,mdss-dsi-fbc-packing = ;
		//qcom,mdss-dsi-fbc-quant-error = ;
		//qcom,mdss-dsi-fbc-bias = ;
		//qcom,mdss-dsi-fbc-pat-mode = ;
		//qcom,mdss-dsi-fbc-vlc-mode = ;
		//qcom,mdss-dsi-fbc-bflc-mode = ;
		//qcom,mdss-dsi-fbc-h-line-budget = ;
		//qcom,mdss-dsi-fbc-budget-ctrl = ;
		//qcom,mdss-dsi-fbc-block-budget = ;
		//qcom,mdss-dsi-fbc-lossless-threshold = ;
		//qcom,mdss-dsi-fbc-lossy-threshold = ;
		//qcom,mdss-dsi-fbc-rgb-threshold = ;
		//qcom,mdss-dsi-fbc-lossy-mode-idx = ;
		//qcom,mdss-dsi-fbc-max-pred-err = ;
		qcom,mdss-dsi-h-back-porch = <80>;
		qcom,mdss-dsi-h-front-porch = <748>;
		qcom,mdss-dsi-h-pulse-width = <1>;
		qcom,mdss-dsi-h-sync-skew = <0>;
		qcom,mdss-dsi-v-back-porch = <10>;
		qcom,mdss-dsi-v-front-porch = <10>;
		qcom,mdss-dsi-v-pulse-width = <1>;
		qcom,mdss-dsi-h-left-border = <0>;
		qcom,mdss-dsi-h-right-border = <0>;
		qcom,mdss-dsi-v-top-border = <0>;
		qcom,mdss-dsi-v-bottom-border = <0>;
		qcom,mdss-dsi-underflow-color = <0xff>;
		qcom,mdss-dsi-border-color = <0>;
		//qcom,mdss-dsi-pan-enable-dynamic-fps = ;
		//qcom,mdss-dsi-pan-fps-update = ;
		//qcom,min-refresh-rate = ;
		//qcom,max-refresh-rate = ;
		qcom,mdss-dsi-bl-pmic-control-type = "bl_ctrl_dcs";
		//qcom,mdss-dsi-bl-pwm-pmi = ;
		//qcom,mdss-dsi-bl-pmic-bank-select = ;
		//qcom,mdss-dsi-bl-pmic-pwm-frequency = ;
		//qcom,mdss-dsi-pwm-gpio = ;
		qcom,mdss-dsi-bl-min-level = <1>;
		qcom,mdss-dsi-bl-max-level = <256>;
		qcom,mdss-brightness-max-level = <256>;
		//qcom,mdss-dsi-interleave-mode = ;
		qcom,mdss-dsi-panel-type = "dsi_video_mode";
		//qcom,5v-boost-gpio = ;
		//qcom,mdss-dsi-te-check-enable = ;
		//qcom,mdss-dsi-te-using-te-pin = ;
		//qcom,mdss-dsi-te-pin-select = ;
		//qcom,mdss-dsi-te-dcs-command = ;
		//qcom,mdss-dsi-wr-mem-start = ;
		//qcom,mdss-dsi-wr-mem-continue = ;
		qcom,mdss-dsi-h-sync-pulse = <0>;
		qcom,mdss-dsi-hfp-power-mode;
		//qcom,mdss-dsi-hbp-power-mode;
		//qcom,mdss-dsi-hsa-power-mode;
		//qcom,mdss-dsi-last-line-interleave = ;
		qcom,mdss-dsi-bllp-eof-power-mode;
		qcom,mdss-dsi-bllp-power-mode;
		qcom,mdss-dsi-traffic-mode = "burst_mode";
		qcom,mdss-dsi-pixel-packing = "loose";
		qcom,mdss-dsi-virtual-channel-id = <0>;
		qcom,mdss-dsi-color-order = <0>;
		qcom,mdss-dsi-lane-0-state;
		qcom,mdss-dsi-lane-1-state;
		qcom,mdss-dsi-lane-2-state;
		qcom,mdss-dsi-lane-3-state;
		qcom,mdss-dsi-t-clk-post = <0x03>;
		qcom,mdss-dsi-t-clk-pre = <0x1C>;
		qcom,mdss-dsi-stream = <0>;
		qcom,mdss-dsi-mdp-trigger = "none";
		qcom,mdss-dsi-dma-trigger = "trigger_sw";
		qcom,mdss-dsi-panel-framerate = <60>;
		qcom,mdss-dsi-panel-clockrate = <728000000>;
		//qcom,mdss-mdp-transfer-time-us = ;
		qcom,mdss-dsi-on-command-state = "dsi_lp_mode"; /* TD4100 : CLK & DATA should be LP11 for 80ms after reset. So we send init_cmds before TG enable */
		qcom,mdss-dsi-off-command-state = "dsi_hs_mode";
		//qcom,mdss-dsi-post-mode-switch-on-command-state = ;
		qcom,mdss-pan-physical-width-dimension = <62>;
		qcom,mdss-pan-physical-height-dimension = <106>;
		//qcom,mdss-dsi-panel-mode-gpio-state = ;
		//qcom,mdss-tear-check-disable = ;
		//qcom,mdss-tear-check-sync-cfg-height = ;
		//qcom,mdss-tear-check-sync-init-val = ;
		//qcom,mdss-tear-check-sync-threshold-start = ;
		//qcom,mdss-tear-check-sync-threshold-continue = ;
		//qcom,mdss-tear-check-start-pos = ;
		//qcom,mdss-tear-check-rd-ptr-trigger-intr = ;
		//qcom,mdss-tear-check-frame-rate = ;
		qcom,mdss-dsi-reset-sequence = <1 1>, <0 1>, <1 0>;
		//qcom,partial-update-enabled = ;
		//qcom,mdss-dsi-horizontal-line-idle = ;
		//qcom,partial-update-roi-merge = ;
		//qcom,dcs-cmd-by-left = ;
		qcom,mdss-dsi-lp11-init;
		qcom,mdss-dsi-init-delay-us = <100>;
		qcom,mdss-dsi-rx-eot-ignore;
		qcom,mdss-dsi-tx-eot-append;
		//qcom,ulps-enabled = ;
		//qcom,suspend-ulps-enabled = ;
		//qcom,panel-roi-alignment = ;
		qcom,esd-check-enabled;
		//qcom,mdss-dsi-panel-status-command = ;
		//qcom,mdss-dsi-panel-status-command-mode = ;
		qcom,mdss-dsi-panel-status-check-mode="reg_read_irq";
		//qcom,mdss-dsi-panel-status-read-length = ;
		//qcom,mdss-dsi-panel-status-valid-params = ;
		//qcom,mdss-dsi-panel-status-value = ;
		//qcom,mdss-dsi-panel-max-error-count = ;
		//qcom,dynamic-mode-switch-enabled = ;
		//qcom,dynamic-mode-switch-type = ;
		//qcom,mdss-dsi-post-mode-switch-on-command = ;
		//qcom,video-to-cmd-mode-switch-commands = ;
		//qcom,cmd-to-video-mode-switch-commands = ;
		//qcom,mdss-dsi-panel-orientation = ;
		//qcom,panel-ack-disabled = ;
		//qcom,mdss-dsi-force-clock-lane-hs; /* TD4100 : CLK & DATA should be LP11 for 80ms after reset.  samsung,dsi_force_clock_lane_hs is enabled*/
		//qcom,compression-mode = ;
		//qcom,panel-supply-entries = ;
		//qcom,config-select = ;
		//qcom,lm-split = ;
		//qcom,split-mode = ;
		//qcom,mdss-dsc-encoders = ;
		//qcom,mdss-dsc-slice-height = ;
		//qcom,mdss-dsc-slice-width = ;
		//qcom,mdss-dsc-slice-per-pkt = ;
		//qcom,mdss-dsc-bit-per-component = ;
		//qcom,mdss-dsc-bit-per-pixel = ;
		//qcom,mdss-dsc-block-prediction-enable = ;
		//qcom,mdss-dsc-config-by-manufacture-cmd = ;
		//qcom,dba-panel = ;
		//qcom,bridge-name = ;
		//qcom,adjust-timer-wakeup-ms = ;
		//qcom,mdss-dsi-display-timings = ;
		//qcom,mdss-dsi-timing-default = ;
		//qcom,mdss-dsi-timing-switch-command = ;
		//qcom,mdss-dsi-timing-switch-command-state  = ;

/*
 * ************************************************************************************************************************************
 *
 *
 *			Below  parameters are samsung dependent thigs
 *
 *
 * ************************************************************************************************************************************
 */
 		samsung,panel-vendor = "BOE";
		samsung,tft-common-support;
		samsung,enter_hbm_lux = <20000>;
		samsung,support_mdnie_lite;

		samsung,mdss-power-off-reset-delay-us = <4000>;

		samsung,dsi_force_clock_lane_hs;  /* TD4100 : CLK & DATA should be LP11 for 80ms after reset. */

		/* To use device_resume & device_suspend for optimizing display on time */
		samsung,reduce_display_on_time;
		samsung,wait_after_reset_delay = <80>; /* Flash loading time */
		samsung,wait_after_sleep_out_delay = <100>; /* 6frames 16.6 * 6 = about 100ms*/

		samsung,level1_key_enable_tx_cmds_revA = [
			39 01 00 00 00 00 02 B0 04
		];
		samsung,level1_key_disable_tx_cmds_revA = [
			39 01 00 00 00 00 02 B0 04
		];

		samsung,packet_size_tx_cmds_revA = [
			37 01 00 00 00 00 02 07 00
		];

		samsung,display_on_tx_cmds_revA = [
			05 01 00 00 00 00 02 29 00
		];

		samsung,display_off_tx_cmds_revA = [05 01 00 00 00 00 02 28 00];

		/*
		 * First parameters can be changed
		 * by function of samsung_nv_read()
		 * because of that means offset of
		 * read position
		 */
		samsung,reg_read_pos_tx_cmds_revA = [
			15 01 00 00 00 00 02 B0 00
		];
		samsung,manufacture_id0_rx_cmds_revA = [06 01 00 00 00 00 01 da 01 00];
		samsung,manufacture_id1_rx_cmds_revA = [06 01 00 00 00 00 01 db 01 00];
		samsung,manufacture_id2_rx_cmds_revA = [06 01 00 00 00 00 01 dc 01 00];

		samsung,tft_pwm_tx_cmds_revA=[
			39 01 00 00 00 00 02 51 FF/*First command should be PWM duty change command*/
		];
		samsung,cabc_on_tx_cmds_revA = [
			39 01 00 00 00 00 02 55 01
		];
		samsung,cabc_off_tx_cmds_revA = [
			39 01 00 00 00 00 02 55 00
		];
		/*
		* ************************************************************************************************************************
		* Scaled level to index mappings
		* ************************************************************************************************************************
		*/
		samsung,candela_map_table_revA = <
		/*<idx>	  <from>  <till> <scaled_level> */
			0		0		0		0
			2		1		2		4		/* MIN 4 CD */
			3		3		3		9
			4		4		5		11
			5		6		6		13
			6		7		8		15
			7		9		9		18
			8		10		11		20		/* DIMMING 20 CD */
			9		12		13		23
			10		14		16		26
			11		17		18		28
			12		19		20		31
			13		21		22		34
			14		23		25		37
			15		26		27		40
			16		28		29		43
			17		30		31		45
			18		32		33		48
			19		34		36		51
			20		37		38		54
			21		39		40		57
			22		41		42		60
			23		43		45		62
			24		46		47		65
			25		48		49		68
			26		50		51		71
			27		52		54		74
			28		55		56		77
			29		57		58		79
			30		59		60		82
			31		61		62		85
			32		63		65		88
			33		66		67		91
			34		68		69		94
			35		70		71		96
			36		72		74		99
			37		75		76		102
			38		77		78		105
			39		79		80		108
			40		81		82		111
			41		83		85		113
			42		86		87		116
			43		88		89		119
			44		90		91		122
			45		92		94		125
			46		95		96		128
			47		97		98		130
			48		99		100		133
			49		101		103		136
			50		104		105		139
			52		106		107		142
			54		108		109		145
			56		110		111		147
			58		112		114		150
			60		115		116		153
			62		117		118		156
			64		119		120		159
			66		121		123		162
			68		124		125		164
			70		126		127		167
			72		128		131		170		/* DEFAULT 170 CD */
			73		132		135		177
			76		136		138		184
			79		139		142		191
			82		143		146		198
			85		147		150		205
			88		151		153		212
			91		154		157		219
			94		158		161		226
			97		162		165		233
			100		166		168		240
			103		169		172		247
			106		173		176		254
			109		177		180		261
			112		181		183		268
			115		184		187		275
			118		188		191		282
			121		192		195		288
			124		196		198		295
			127		199		202		302
			130		203		206		309
			133		207		210		316
			136		211		213		323
			139		214		217		330
			142		218		221		337
			145		222		225		344
			148		226		228		351
			151		229		232		358
			154		233		236		365
			157		237		240		372
			160		241		243		379
			163		244		247		386
			166		248		251		393
			169		252		255		400		/* MAX 400 CD */
			219		256		256		480		/* OUTDOOR 480 CD */
		>;
	};
};
