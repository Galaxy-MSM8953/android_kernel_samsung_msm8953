/* Copyright (c) 2013-14, Samsung Electronics Corporation. All rights reserved.
 *
 * This program is free software; you can redistribute it and/or modify
 * it under the terms of the GNU General Public License version 2 and
 * only version 2 as published by the Free Software Foundation.
 *
 * This program is distributed in the hope that it will be useful,
 * but WITHOUT ANY WARRANTY; without even the implied warranty of
 * MERCHANTABILITY or FITNESS FOR A PARTICULAR PURPOSE.  See the
 * GNU General Public License for more details.
 */

/*---------------------------------------------------------------------------
 * This file is autogenerated file using gcdb parser. Please do not edit it.
 * Update input XML file to add a new entry or update variable in this file
 * VERSION = "1.0"
 *---------------------------------------------------------------------------*/
&mdss_mdp {
	ss_dsi_panel_S6D78A0_BV050SQM_QHD: ss_dsi_panel_S6D78A0_BV050SQM_QHD {
		qcom,mdss-dsi-panel-name = "ss_dsi_panel_S6D78A0_BV050SQM_QHD";
		qcom,mdss-dsi-panel-controller = <&mdss_dsi0>;
		qcom,mdss-dsi-panel-width = <540>;
		qcom,mdss-dsi-panel-height = <960>;
		qcom,mdss-dsi-bpp = <24>;
		qcom,mdss-dsi-panel-destination = "display_1";
		qcom,mdss-dsi-panel-timings = [87 1C 12 00 40 44 16 1E 17 03 04 00];
		qcom,mdss-dsi-on-command = [
			/* Initializing Sequence(1)*/
			39 00 00 00 00 00 03 F0 5A 5A
			39 00 00 00 00 00 03 F1 5A 5A
			39 00 00 00 00 00 03 FC A5 A5

			/* R11h and delay of 120ms*/
			05 01 00 00 78 00 02 11 00
			
			/* Initializing Sequence(3)*/
			39 00 00 00 00 00 02 B1 93
			39 00 00 00 00 00 02 B5 10
			39 00 00 00 00 00 12 F4 01 10 32 00 24 26 28 27 27 27 B7 2B 2C 65 6A 34 20
			39 00 00 00 00 00 15 EF 01 01 81 22 83 04 05 00 00 00 28 81 00 21 21 03 03 40 00 10
			39 00 00 00 00 00 09 F2 19 04 08 08 08 3F 23 00
			39 00 00 00 00 00 07 F6 63 23 15 00 00 06
			39 00 00 00 00 00 07 E1 01 FF 01 1B 20 17
			39 00 00 00 00 00 04 E2 ED C7 23
			39 00 00 00 00 00 27 F7 01 01 01 0A 0B 00 1A 05 1B 01 01 01 01 01 01 01 01 01 01 01 01 01 08 09 00 1A 04 1B 01 01 01 01 01 01 01 01 01 01
			39 00 00 00 00 00 02 36 10

			/* Gamma Setting Sequence*/

			
			39 00 00 00 00 00 28 FA 11 3B 33 2A 1A 09 08 04 03 07 05 06 17 12 3B 33 2A 1D 0B 07 04 03 07 05 07 17 10 3B 33 2A 1A 07 05 02 02 05 03 04 15
			39 00 00 00 00 00 28 FB 11 3B 33 2A 1A 0A 08 04 03 06 05 06 17 12 3B 33 2A 1D 0B 07 04 03 07 05 07 17 10 3B 33 2A 1A 08 05 02 02 05 03 04 14

			/* R29h and delay of 20ms*/
			05 01 00 00 14 00 02 29 00
			
			/* Initializing Sequence(2) */
			39 00 00 00 00 00 03 F0 A5 A5
			39 00 00 00 00 00 03 F1 A5 A5
			39 00 00 00 00 00 03 FC 5A 5A
		];
		qcom,mdss-dsi-off-command = [
			05 01 00 00 32 00 02 28 00	/*  wait 50ms */
			05 01 00 00 32 00 02 10 00	/*  wait 50ms */
		];

		qcom,mdss-dsi-h-front-porch = <35>;
		qcom,mdss-dsi-h-back-porch = <35>;
		qcom,mdss-dsi-h-pulse-width = <28>;
		qcom,mdss-dsi-v-back-porch = <6>;
		qcom,mdss-dsi-v-front-porch = <8>;
		qcom,mdss-dsi-v-pulse-width = <2>;

		qcom,mdss-dsi-h-sync-skew = <0>;		
		qcom,mdss-dsi-h-left-border = <0>;
		qcom,mdss-dsi-h-right-border = <0>;
		qcom,mdss-dsi-v-top-border = <0>;
		qcom,mdss-dsi-v-bottom-border = <0>;
		qcom,mdss-dsi-underflow-color = <0xff>;
		qcom,mdss-dsi-border-color = <0>;
		qcom,mdss-dsi-bl-pmic-control-type = "bl_ctrl_ss_pwm";
		qcom,mdss-dsi-bl-min-level = <1>;
		qcom,mdss-dsi-bl-max-level = <255>;
		qcom,mdss-brightness-max-level = <255>;
		qcom,mdss-dsi-panel-type = "dsi_video_mode";
		qcom,mdss-dsi-h-sync-pulse = <0>;
		//qcom,mdss-dsi-hfp-power-mode;
		qcom,mdss-dsi-bllp-eof-power-mode;
		qcom,mdss-dsi-bllp-power-mode;
		qcom,mdss-dsi-traffic-mode = "burst_mode";
		qcom,mdss-dsi-pixel-packing = "loose";
		qcom,mdss-dsi-virtual-channel-id = <0>;
		qcom,mdss-dsi-color-order = <0>;
		qcom,mdss-dsi-lane-0-state;
		qcom,mdss-dsi-lane-1-state;
		qcom,mdss-dsi-t-clk-post = <0x04>;
		qcom,mdss-dsi-t-clk-pre = <0x1B>;
		qcom,mdss-dsi-stream = <0>;
		qcom,mdss-dsi-mdp-trigger = "none";
		qcom,mdss-dsi-dma-trigger = "trigger_sw";
		qcom,mdss-dsi-panel-framerate = <60>;
		qcom,mdss-dsi-panel-clockrate = <460000000>;
		qcom,mdss-dsi-on-command-state = "dsi_lp_mode";
		qcom,mdss-dsi-off-command-state = "dsi_hs_mode";
		qcom,mdss-pan-physical-width-dimension = <64>;
		qcom,mdss-pan-physical-height-dimension = <110>;
		qcom,mdss-dsi-lp11-init;
		qcom,mdss-dsi-init-delay-us = <100>;
		qcom,mdss-dsi-rx-eot-ignore;
		qcom,mdss-dsi-tx-eot-append;

/*
 * ************************************************************************************************************************************
 *
 *
 *			Below  parameters are samsung dependent thigs
 *
 *
 * ************************************************************************************************************************************
 */
 		samsung,panel-vendor = "BOE";
		samsung,tft-common-support;
		samsung,panel-backlight-tft-gpio1 = <&tlmm 94 GPIOF_OUT_INIT_HIGH>;

		/* To use device_resume & device_suspend for optimizing display on time */
		samsung,reduce_display_on_time;
		samsung,dsi_force_clock_lane_hs;
		samsung,wait_after_reset_delay = <80>; /* Flash loading time */
		samsung,wait_after_sleep_out_delay = <107>; /* More than 6frame 16.6 * 6 = 99.6ms+7ms*/
		
		samsung,display_off_tx_cmds_revA = [05 01 00 00 32 00 02 28 00];

		samsung,level1_key_enable_tx_cmds_revA = [
			39 00 00 00 00 00 03 F0 5A 5A
		];
		samsung,level1_key_disable_tx_cmds_revA = [
			39 00 00 00 00 00 03 F0 A5 A5
		];
		samsung,level2_key_enable_tx_cmds_revA = [
			39 00 00 00 00 00 03 FC A5 A5
		];
		samsung,level2_key_disable_tx_cmds_revA = [
			39 00 00 00 00 00 03 FC 5A 5A
		];

		/*
		 * First parameters can be changed
		 * by function of samsung_nv_read()
		 * because of that means offset of
		 * read position
		 */
		samsung,reg_read_pos_tx_cmds_revA = [
			15 01 00 00 00 00 02 B0 00
		];

		samsung,manufacture_id0_rx_cmds_revA = [06 01 00 00 00 00 01 da 01 00];
		samsung,manufacture_id1_rx_cmds_revA = [06 01 00 00 00 00 01 db 01 00];
		samsung,manufacture_id2_rx_cmds_revA = [06 01 00 00 00 00 01 dc 01 00];
		/*
		* ************************************************************************************************************************
		* Scaled level to index mappings
		* ************************************************************************************************************************
		*/
		samsung,scaled_level_map_table_revA = <
		/* <idx>	    <from>       <till>     <scaled_level> */
			0		0		0		0
			1		1		7		32
			2		8		13		31
			3		14		19		30
			4		20		25		29
			5		26		31		28
			6		32		37		27
			7		38		43		26
			8		44		49		25
			9		50		56		24
			10		57		64		23
			11		65		72		22
			12		73		80		21
			13		81		88		20
			14		89		96		19
			15		97		105		18
			16		106		114		17
			17		115		123		16
			18		124		133		15
			19		134		143		14
			20		144		153		13
			21		154		163		12
			22		164		173		11
			23		174		183		10
			24		184		193		9
			25		194		203		8
			26		204		213		7
			27		214		223		6
			28		224		233		5
			29		234		243		4
			30		244		255		3
			>;
	};
};